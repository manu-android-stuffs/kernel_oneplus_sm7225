## drivers/oneplus/input/touchscreen/Goodix/GT9886/Kconfig
```kconfig
config TOUCHPANEL_GOODIX_GT9886
   default n
    bool "TP goodix gt9886 IC enable or not for OPPO"
    ---help---
    say Y to enable driver for Touchpanel useing goodix gt9886
```
